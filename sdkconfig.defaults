## sdkconfig.defaults
```kconfig
# Rust often needs a bit of an extra main task stack size compared to C (the default is 3K)
CONFIG_ESP_MAIN_TASK_STACK_SIZE=8000

# Use this to set FreeRTOS kernel tick frequency to 1000 Hz (100 Hz by default).
# This allows to use 1 ms granuality for thread sleeps (10 ms by default).
CONFIG_FREERTOS_HZ=10

# Workaround for https://github.com/espressif/esp-idf/issues/7631
CONFIG_MBEDTLS_CERTIFICATE_BUNDLE=n
CONFIG_MBEDTLS_CERTIFICATE_BUNDLE_DEFAULT_FULL=n
#CONFIG_LOG_DEFAULT_LEVEL_INFO=n
CONFIG_LOG_DEFAULT_LEVEL=1
CONFIG_LOG_MAXIMUM_LEVEL=1
CONFIG_BOOTLOADER_LOG_LEVEL_INFO=n
CONFIG_ESP_MAIN_TASK_AFFINITY=CPU1
CONFIG_PTHREAD_TASK_CORE_DEFAULT=0
CONFIG_PTHREAD_DEFAULT_CORE_0=y
CONFIG_APPTRACE_SV_ENABLE=y
CONFIG_APPTRACE_SV_DEST_UART=y
CONFIG_APPTRACE_SV_DEST_CPU_1=y
CONFIG_LOG_BOOTLOADER_LEVEL_NONE=y
CONFIG_APPTRACE_SV_EVT_ISR_ENTER_ENABLE=y
CONFIG_APPTRACE_SV_EVT_ISR_EXIT_ENABLE=y
CONFIG_APPTRACE_SV_EVT_ISR_TO_SCHED_ENABLE=y
CONFIG_APPTRACE_SV_EVT_TASK_START_EXEC_ENABLE=y
CONFIG_APPTRACE_SV_EVT_TASK_STOP_EXEC_ENABLE=y
CONFIG_BT_ENABLED=n

CONFIG_ESP_TASK_WDT_EN=n
CONFIG_ESP_TASK_WDT_CHECK_IDLE_TASK_CPU1=n
CONFIG_ESP_INT_WDT_CHECK_CPU1=n
CONFIG_ESP_TASK_WDT_INIT=n

#CONFIG_ESP_WIFI_EXTRA_IRAM_OPT=y
#CONFIG_ESP_WIFI_RX_IRAM_OPT=y
#CONFIG_ESP_WIFI_IRAM_OPT=y
#CONFIG_RMT_ISR_IRAM_SAFE=y

CONFIG_ESP_WIFI_ENABLE_WPA3_SAE=n
CONFIG_ESP_WIFI_MBEDTLS_CRYPTO=n



CONFIG_ESP_WIFI_ENABLE_WPA3_SAE=n
CONFIG_ESP_WIFI_SOFTAP_SUPPORT=y
CONFIG_ESP_WIFI_ENTERPRISE_SUPPORT=n

#CONFIG_LWIP_IPV6=n
CONFIG_VFS_SUPPORT_IO=n
```
